## drivers/doscom/Kconfig
```kconfig
#
# File: driver/doscom/Kconfig
#
config DOSCOM
	bool "SafeG-COM"
	default y
	help
	  Enable SafeG Dual-OS communications framework.

# End of File: driver/doscom/Kconfig
```

## drivers/topmon/Kconfig
```kconfig
# File: linux-imx/drivers/topmon/Kconfig
# Overview: Configure the TOPMON parent switch and REE-to-TEE SMC notifications.

menuconfig TOPMON
    bool "TOPMON - Trusted Runtime Monitoring"
    depends on ARM64
    default y
    help
      Enable the TOPMON proof-of-concept infrastructure.

if TOPMON

config TOPMON_LKRG_ALERT
    bool "LKRG alert notification to TEE (IRQ 85)"
    default y
    help
      Send LKRG detection alerts to TOPPERS/FMP3 through SMC.
      The LKRG module must be built consistently with this setting.

config TOPMON_LKRG_TEE
    bool
    depends on TOPMON "TOPMON kernel-code integrity notification to TEE (IRQ 87)"
    depends on CRYPTO_SHA256
    default y
    help
      Publish the reference hash and physical location of the TOPMON
      kernel-code section to TOPPERS/FMP3.

endif

# End of File: linux-imx/drivers/topmon/Kconfig
```

## security/integrity-zt/Kconfig
```kconfig
# linux-imx/security/integrity-zt/Kconfig

config INTEGRITY_ZT_LKRG
	bool "Zero-Trust Integrity Monitor for LKRG (Panic Mode)"
	depends on CRYPTO_SHA256
	default y

choice
	prompt "Integrity Capture Timing"
	depends on INTEGRITY_ZT_LKRG
	default INTEGRITY_ZT_CAPTURE_COMING
	help
	  Select when to capture the 'Gold Hash' of the LKRG module.

config INTEGRITY_ZT_CAPTURE_COMING
	bool "Capture on COMING (Pre-init)"
	help
	  This option enables periodic integrity monitoring of the LKRG module.
	  If tampering is detected in the first 4KB of the .text section,
	  the kernel will trigger an immediate Panic to protect the system.

config INTEGRITY_ZT_CAPTURE_LIVE
	bool "Capture on LIVE (Post-init)"
	help
	  Captures hash after the module is fully initialized and
	  relocations/alternatives are applied. (Recommended)
endchoice

config INTEGRITY_ZT_CHECK_INTERVAL_SEC
	int "Integrity Check Interval (seconds)"
	depends on INTEGRITY_ZT_LKRG
	range 1 3600
	default 15
	help
	  Interval in seconds between periodic integrity checks.
	  Lower values increase security but add CPU overhead.

# End of File
```

## security/topmon/Kconfig
```kconfig
# File: linux-imx/security/topmon/Kconfig
# Overview: Configure LKRG integrity monitoring and reference-hash capture.

if TOPMON

config TOPMON_LKRG
    bool "LKRG module integrity monitoring"
    depends on TOPMON && CRYPTO_SHA256 && MODULES
    default y
    help
      Monitor the loaded LKRG module text and restart on a hash mismatch.

if TOPMON_LKRG

choice
    prompt "LKRG reference hash capture timing"
    default TOPMON_LKRG_CAPTURE_LIVE

config TOPMON_LKRG_CAPTURE_COMING
    bool "COMING - capture during module loading"

config TOPMON_LKRG_CAPTURE_LIVE
    bool "LIVE - capture after module initialization (recommended)"

endchoice

config TOPMON_LKRG_CHECK_INTERVAL_SEC
    int "LKRG integrity check interval (seconds)"
    range 1 3600
    default 15

endif

config TOPMON_CORE
    bool
    depends on TOPMON
    default y if TOPMON_LKRG || TOPMON_LKRG_TEE

endif

# End of File: linux-imx/security/topmon/Kconfig
```
